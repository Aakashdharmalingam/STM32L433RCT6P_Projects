# file: External Interrupt.ioc
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Mcu.Family=STM32L4
Mcu.Name=STM32L433RCTxP
Mcu.Package=LQFP64
NVIC.PriorityGroup=NVIC_PRIORITYGROUP_4
PB7.Signal=GPXTI7
ProjectManager.HeapSize=0x200
ProjectManager.StackSize=0x400
ProjectManager.TargetToolchain=STM32CubeIDE
RCC.HSE_VALUE=8000000
RCC.HSI48_VALUE=48000000
RCC.HSI_VALUE=16000000
RCC.LSE_VALUE=32768
RCC.MSI_VALUE=4000000
RCC.VCOOutputFreq_Value=32000000
board=custom

// file: Core/Src/main.c
/* USER CODE BEGIN Header */
/**
  ******************************************************************************
  * @file           : main.c
  * @brief          : Main program body
  ******************************************************************************
  * @attention
  *
  * Copyright (c) 2025 STMicroelectronics.
  * All rights reserved.
  *
  * This software is licensed under terms that can be found in the LICENSE file
  * in the root directory of this software component.
  * If no LICENSE file comes with this software, it is provided AS-IS.
  *
  ******************************************************************************
  */
/* USER CODE END Header */
#include "main.h"

void SystemClock_Config(void);
static void MX_GPIO_Init(void);

int main(void)
{

  /* MCU Configuration--------------------------------------------------------*/

  /* Reset of all peripherals, Initializes the Flash interface and the Systick. */
  HAL_Init();

  /* Configure the system clock */
  SystemClock_Config();

  /* Initialize all configured peripherals */
  MX_GPIO_Init();
  /* USER CODE BEGIN 2 */
  	RCC->AHB2ENR |= RCC_AHB2ENR_GPIOBEN; //0b0010 enable clock signal for GPIOB to set in RCC register
  	RCC->APB2ENR |= RCC_APB2ENR_SYSCFGEN; // enable interrupts while enable sysconfig
  	//JUST ENABLE THE PORTB CLOCK
  	//Blinking LED CONFIG PB13
  	GPIOB->MODER |= GPIO_MODER_MODE13_0;  //0b0000 0010<<26  This is for set
  	GPIOB->MODER &= ~(GPIO_MODER_MODE13_1);  /// this is for clear

  	//led is interrupt config on PB8
  	GPIOB->MODER |= GPIO_MODER_MODE8_0;
  	GPIOB->MODER &= ~GPIO_MODER_MODE8_1;

  	//EXTERNAL INTERRUPT
  	//PB4
  	EXTI->IMR1 |= EXTI_IMR1_IM4;  //UNMASKED
  	EXTI->RTSR1 |= EXTI_RTSR1_RT4; // rising edge
  	SYSCFG->EXTICR[1] |= SYSCFG_EXTICR2_EXTI4_PB ;  //WHICH PIN
  	NVIC_EnableIRQ(EXTI4_IRQn); // jump into interrupt function
  /* USER CODE END 2 */

  /* Infinite loop */
  /* USER CODE BEGIN WHILE */
  while (1)
  {
	  // Main program Led blinking
	  GPIOB->ODR |= GPIO_ODR_OD8; // set state high
	  HAL_Delay(1000);

	  GPIOB->ODR &= ~GPIO_ODR_OD8; // reset state low
	  HAL_Delay(1000); // delay for 1 second
	  //LED OFF
    /* USER CODE END WHILE */

  }
}

void SystemClock_Config(void)
{
  RCC_OscInitTypeDef RCC_OscInitStruct = {0};
  RCC_ClkInitTypeDef RCC_ClkInitStruct = {0};

  /** Configure the main internal regulator output voltage
  */
  if (HAL_PWREx_ControlVoltageScaling(PWR_REGULATOR_VOLTAGE_SCALE1) != HAL_OK)
  {
    Error_Handler();
  }

  /** Initializes the RCC Oscillators according to the specified parameters
  * in the RCC_OscInitTypeDef structure.
  */
  RCC_OscInitStruct.OscillatorType = RCC_OSCILLATORTYPE_MSI;
  RCC_OscInitStruct.MSIState = RCC_MSI_ON;
  RCC_OscInitStruct.MSICalibrationValue = 0;
  RCC_OscInitStruct.MSIClockRange = RCC_MSIRANGE_6;
  RCC_OscInitStruct.PLL.PLLState = RCC_PLL_NONE;
  if (HAL_RCC_OscConfig(&RCC_OscInitStruct) != HAL_OK)
  {
    Error_Handler();
  }

  /** Initializes the CPU, AHB and APB buses clocks
  */
  RCC_ClkInitStruct.ClockType = RCC_CLOCKTYPE_HCLK|RCC_CLOCKTYPE_SYSCLK
                              |RCC_CLOCKTYPE_PCLK1|RCC_CLOCKTYPE_PCLK2;
  RCC_ClkInitStruct.SYSCLKSource = RCC_SYSCLKSOURCE_MSI;
  RCC_ClkInitStruct.AHBCLKDivider = RCC_SYSCLK_DIV1;
  RCC_ClkInitStruct.APB1CLKDivider = RCC_HCLK_DIV1;
  RCC_ClkInitStruct.APB2CLKDivider = RCC_HCLK_DIV1;

  if (HAL_RCC_ClockConfig(&RCC_ClkInitStruct, FLASH_LATENCY_0) != HAL_OK)
  {
    Error_Handler();
  }
}

static void MX_GPIO_Init(void)
{
  GPIO_InitTypeDef GPIO_InitStruct = {0};

  /* GPIO Ports Clock Enable */
  __HAL_RCC_GPIOB_CLK_ENABLE();

  /*Configure GPIO pin : PB7 */
  GPIO_InitStruct.Pin = GPIO_PIN_7;
  GPIO_InitStruct.Mode = GPIO_MODE_IT_RISING;
  GPIO_InitStruct.Pull = GPIO_NOPULL;
  HAL_GPIO_Init(GPIOB, &GPIO_InitStruct);

}

/* USER CODE BEGIN 4 */
// Interrupt function while press the button, it jump into this function and then move to main program
void EXTI4_IRQHandler() {
	if((GPIOB->IDR & GPIO_IDR_ID13) ==0) // checking state,if state is low
	{
		GPIOB->ODR |= (GPIO_ODR_OD13); //LED ON then set
	}
	else
		GPIOB->ODR &= ~GPIO_ODR_OD13; // reset

	EXTI->PR1 |= EXTI_PR1_PIF4; // flag interrupt to toggle for next interrupt occurs again jump into this function

}
/* USER CODE END 4 */

void Error_Handler(void)
{
  __disable_irq();
  while (1)
  {
  }
}
