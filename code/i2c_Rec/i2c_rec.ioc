# file: i2c_rec.ioc
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Mcu.Family=STM32L4
Mcu.Name=STM32L433RCTxP
Mcu.Package=LQFP64
NVIC.PriorityGroup=NVIC_PRIORITYGROUP_4
ProjectManager.HeapSize=0x200
ProjectManager.StackSize=0x400
ProjectManager.TargetToolchain=STM32CubeIDE
RCC.HSE_VALUE=8000000
RCC.HSI48_VALUE=48000000
RCC.HSI_VALUE=16000000
RCC.LSE_VALUE=32768
RCC.MSI_VALUE=4000000
RCC.VCOOutputFreq_Value=32000000
board=custom

// file: Core/Src/main.c
/* USER CODE BEGIN Header */
/**
  ******************************************************************************
  * @file           : main.c
  * @brief          : Main program body
  ******************************************************************************
  * @attention
  *
  * Copyright (c) 2025 STMicroelectronics.
  * All rights reserved.
  *
  * This software is licensed under terms that can be found in the LICENSE file
  * in the root directory of this software component.
  * If no LICENSE file comes with this software, it is provided AS-IS.
  *
  ******************************************************************************
  */
/* USER CODE END Header */
#include "main.h"

void SystemClock_Config(void);

/* USER CODE BEGIN 0 */
	uint8_t firstdata = 0;
	uint8_t seconddata = 0;
	int count;
/* USER CODE END 0 */

int main(void)
{

  /* MCU Configuration--------------------------------------------------------*/

  /* Reset of all peripherals, Initializes the Flash interface and the Systick. */
  HAL_Init();

  /* Configure the system clock */
  SystemClock_Config();

  /* Initialize all configured peripherals */
  /* USER CODE BEGIN 2 */
  RCC->APB1ENR1 |= RCC_APB1ENR1_I2C1EN;
  RCC->AHB2ENR  |= RCC_AHB2ENR_GPIOAEN;

  GPIOA->MODER &= ~ GPIO_MODER_MODE10_0;
  GPIOA->MODER &= ~ GPIO_MODER_MODE9_0;

  GPIOA->OSPEEDR |= GPIO_OSPEEDER_OSPEEDR10_0 | GPIO_OSPEEDER_OSPEEDR10_1;
  GPIOA->OSPEEDR |= GPIO_OSPEEDER_OSPEEDR9_0 | GPIO_OSPEEDER_OSPEEDR9_1;

  GPIOA->OTYPER |= ( GPIO_OTYPER_OT10 | GPIO_OTYPER_OT9 );
  GPIOA->PUPDR |= (GPIO_PUPDR_PUPD9_0 | GPIO_PUPDR_PUPD10_0);

  GPIOA->AFR[1] |= GPIO_AFRH_AFSEL10_2 | GPIO_AFRH_AFSEL9_2;

  I2C1->TIMINGR |= 0x00400D10;
  I2C1->CR1 |= I2C_CR1_PE;

  // RECEIVE THE DATA FROM EEPROM MAKE SURE SEND ADDRESS OF MEMORY AND RECIEVE THE DATA
  I2C1->CR2 |= 0x02<<I2C_CR2_NBYTES_Pos; // 2 bytes
  I2C1->CR2 |= I2C_CR2_AUTOEND; // automatice stop
  I2C1->CR2 |= 0xA0<<I2C_CR2_SADD_Pos; // address slave
  //WRITE ENABLE MODE
  I2C1->CR2 &= ~I2C_CR2_RD_WRN;
  I2C1->CR2 |= I2C_CR2_START; // START ENABLE

  while((I2C1->ISR & I2C_ISR_NACKF) != 0);

  while ((I2C1->ISR & I2C_ISR_TXIS) == 0);		///1 BYTES
  I2C1->TXDR = 0x00;

  while ((I2C1->ISR & I2C_ISR_TXIS) == 0);		///1 BYTES
  I2C1->TXDR = 0x00;

  while((I2C1->ISR & I2C_ISR_STOPF)==0);   // CHECK AUTOMATICE FLAG

  HAL_Delay(5);// WAIT

  I2C1->CR2 =0; // clear
  I2C1->CR2 |= 0x01<<I2C_CR2_NBYTES_Pos; // 1 BYTES
  I2C1->CR2 |= I2C_CR2_AUTOEND; // AUTOMATICE FLAG
  I2C1->CR2 |= 0xA0<<I2C_CR2_SADD_Pos; // SLAVE ADDRESS
    // READ ENABLE MODE
  I2C1->CR2 |= I2C_CR2_RD_WRN;
  I2C1->CR2 |= I2C_CR2_START;

  while((I2C1->ISR & I2C_ISR_RXNE) == 0);
  firstdata = I2C1->RXDR;// DATA RECIEVE

  while((I2C1->ISR & I2C_ISR_STOPF)==0);   // CHECK AUTOMATICE FLAG
  /* USER CODE END 2 */

  /* Infinite loop */
  /* USER CODE BEGIN WHILE */
  while (1)
  {
	  count++;
    /* USER CODE END WHILE */

  }
}

void SystemClock_Config(void)
{
  RCC_OscInitTypeDef RCC_OscInitStruct = {0};
  RCC_ClkInitTypeDef RCC_ClkInitStruct = {0};

  /** Configure the main internal regulator output voltage
  */
  if (HAL_PWREx_ControlVoltageScaling(PWR_REGULATOR_VOLTAGE_SCALE1) != HAL_OK)
  {
    Error_Handler();
  }

  /** Initializes the RCC Oscillators according to the specified parameters
  * in the RCC_OscInitTypeDef structure.
  */
  RCC_OscInitStruct.OscillatorType = RCC_OSCILLATORTYPE_MSI;
  RCC_OscInitStruct.MSIState = RCC_MSI_ON;
  RCC_OscInitStruct.MSICalibrationValue = 0;
  RCC_OscInitStruct.MSIClockRange = RCC_MSIRANGE_6;
  RCC_OscInitStruct.PLL.PLLState = RCC_PLL_NONE;
  if (HAL_RCC_OscConfig(&RCC_OscInitStruct) != HAL_OK)
  {
    Error_Handler();
  }

  /** Initializes the CPU, AHB and APB buses clocks
  */
  RCC_ClkInitStruct.ClockType = RCC_CLOCKTYPE_HCLK|RCC_CLOCKTYPE_SYSCLK
                              |RCC_CLOCKTYPE_PCLK1|RCC_CLOCKTYPE_PCLK2;
  RCC_ClkInitStruct.SYSCLKSource = RCC_SYSCLKSOURCE_MSI;
  RCC_ClkInitStruct.AHBCLKDivider = RCC_SYSCLK_DIV1;
  RCC_ClkInitStruct.APB1CLKDivider = RCC_HCLK_DIV1;
  RCC_ClkInitStruct.APB2CLKDivider = RCC_HCLK_DIV1;

  if (HAL_RCC_ClockConfig(&RCC_ClkInitStruct, FLASH_LATENCY_0) != HAL_OK)
  {
    Error_Handler();
  }
}

void Error_Handler(void)
{
  __disable_irq();
  while (1)
  {
  }
}
