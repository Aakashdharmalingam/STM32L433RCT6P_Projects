# file: adc_pwm.ioc
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Mcu.Family=STM32L4
Mcu.Name=STM32L433RCTxP
Mcu.Package=LQFP64
NVIC.PriorityGroup=NVIC_PRIORITYGROUP_4
ProjectManager.HeapSize=0x200
ProjectManager.StackSize=0x400
ProjectManager.TargetToolchain=STM32CubeIDE
RCC.HSE_VALUE=8000000
RCC.HSI48_VALUE=48000000
RCC.HSI_VALUE=16000000
RCC.LSE_VALUE=32768
RCC.MSI_VALUE=4000000
RCC.VCOOutputFreq_Value=32000000
board=custom

// file: Core/Src/main.c
/* USER CODE BEGIN Header */
/**
  ******************************************************************************
  * @file           : main.c
  * @brief          : Main program body
  ******************************************************************************
  * @attention
  *
  * Copyright (c) 2025 STMicroelectronics.
  * All rights reserved.
  *
  * This software is licensed under terms that can be found in the LICENSE file
  * in the root directory of this software component.
  * If no LICENSE file comes with this software, it is provided AS-IS.
  *
  ******************************************************************************
  */
/* USER CODE END Header */
#include "main.h"

void SystemClock_Config(void);

/* USER CODE BEGIN 0 */
float data;
/* USER CODE END 0 */

int main(void)
{

  /* MCU Configuration--------------------------------------------------------*/

  /* Reset of all peripherals, Initializes the Flash interface and the Systick. */
  HAL_Init();

  /* Configure the system clock */
  SystemClock_Config();

  /* Initialize all configured peripherals */
  /* USER CODE BEGIN 2 */
  	RCC->AHB2ENR |= RCC_AHB2ENR_ADCEN;// ADC CLOCK SIGNAL ENABLE

    ADC1_COMMON ->CCR |= ADC_CCR_CKMODE_0;// CLOCK ENABLE

    ADC1->CR &= ~ADC_CR_DEEPPWD;// DEEP SLEEP MODE
    ADC1->CR |= ADC_CR_ADVREGEN;// VOLTAGE
    HAL_Delay(100);// TO CONFIG WAIT FOR
    ADC1->CR &= ~ADC_CR_ADEN;// ADC ENABLE
    ADC1->CR |= ADC_CR_ADCAL;// ADC CALIBRATION

    while((ADC1->CR & ADC_CR_ADCAL) == ADC_CR_ADCAL);//zero
    ADC1->SQR1 |= ADC_SQR1_SQ1_1;// WHICH CHANNEL PINOUT
    ADC1->ISR |= ADC_ISR_ADRDY;
    ADC1->CR |= ADC_CR_ADEN;
    while((ADC1->ISR & ADC_ISR_ADRDY)==0);

    //PWM CONFIG TIMER
    RCC->AHB2ENR |= RCC_AHB2ENR_GPIOAEN; //CLOCK SIGNAL GPIO PIN
    RCC->APB1ENR1 |= RCC_APB1ENR1_TIM2EN;// CLOCK SIGNAL TIMER2 PIN

    	//This is for alternate functions PA0
    GPIOA->MODER |= GPIO_MODER_MODE0_1;  //
    GPIOA->MODER &= ~(GPIO_MODER_MODE0_0);  /// this is for clear
    GPIOA->AFR[0] |= GPIO_AFRL_AFSEL0_0;  //TIM 2 CHANNEL 1 0001->AF1

    TIM2->PSC = 400;/// 10Hz -> 100ms period
    TIM2->ARR = 1000+1;
    TIM2->CCR1 = 0;///0 to 1000 DUTY CYCLE
    TIM2->CCMR1 |= TIM_CCMR1_OC1M_1 | TIM_CCMR1_OC1M_2 | TIM_CCMR1_OC1PE;
    TIM2->CCER |= TIM_CCER_CC1E;
    TIM2->CR1 |= TIM_CR1_CEN;//ENABLE COUNTER

  /* USER CODE END 2 */

  /* Infinite loop */
  /* USER CODE BEGIN WHILE */
  while (1)
  {
	  ADC1->CR |= ADC_CR_ADSTART;// START ADC
	  while((ADC1->ISR & ADC_ISR_EOC)==0);// END OF CONVERSION
	  ADC1->ISR |= ADC_ISR_EOC; // SET THE FLAG
	  data = ADC1->DR; // DATA

		//CCR1 = 0 to 1000
		//data = 0 to 4095

	  TIM2->CCR1 = ((data*0.0002)*1001.0); //normalizing ((data / 4095)*1000);
	  HAL_Delay(100);
    /* USER CODE END WHILE */

  }
}

void SystemClock_Config(void)
{
  RCC_OscInitTypeDef RCC_OscInitStruct = {0};
  RCC_ClkInitTypeDef RCC_ClkInitStruct = {0};

  /** Configure the main internal regulator output voltage
  */
  if (HAL_PWREx_ControlVoltageScaling(PWR_REGULATOR_VOLTAGE_SCALE1) != HAL_OK)
  {
    Error_Handler();
  }

  /** Initializes the RCC Oscillators according to the specified parameters
  * in the RCC_OscInitTypeDef structure.
  */
  RCC_OscInitStruct.OscillatorType = RCC_OSCILLATORTYPE_MSI;
  RCC_OscInitStruct.MSIState = RCC_MSI_ON;
  RCC_OscInitStruct.MSICalibrationValue = 0;
  RCC_OscInitStruct.MSIClockRange = RCC_MSIRANGE_6;
  RCC_OscInitStruct.PLL.PLLState = RCC_PLL_NONE;
  if (HAL_RCC_OscConfig(&RCC_OscInitStruct) != HAL_OK)
  {
    Error_Handler();
  }

  /** Initializes the CPU, AHB and APB buses clocks
  */
  RCC_ClkInitStruct.ClockType = RCC_CLOCKTYPE_HCLK|RCC_CLOCKTYPE_SYSCLK
                              |RCC_CLOCKTYPE_PCLK1|RCC_CLOCKTYPE_PCLK2;
  RCC_ClkInitStruct.SYSCLKSource = RCC_SYSCLKSOURCE_MSI;
  RCC_ClkInitStruct.AHBCLKDivider = RCC_SYSCLK_DIV1;
  RCC_ClkInitStruct.APB1CLKDivider = RCC_HCLK_DIV1;
  RCC_ClkInitStruct.APB2CLKDivider = RCC_HCLK_DIV1;

  if (HAL_RCC_ClockConfig(&RCC_ClkInitStruct, FLASH_LATENCY_0) != HAL_OK)
  {
    Error_Handler();
  }
}

void Error_Handler(void)
{
  __disable_irq();
  while (1)
  {
  }
}
