# file: adc.ioc
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Mcu.Family=STM32L4
Mcu.Name=STM32L433RCTxP
Mcu.Package=LQFP64
NVIC.PriorityGroup=NVIC_PRIORITYGROUP_4
ProjectManager.HeapSize=0x200
ProjectManager.StackSize=0x400
ProjectManager.TargetToolchain=STM32CubeIDE
RCC.ADCFreq_Value=32000000
RCC.HSE_VALUE=8000000
RCC.HSI48_VALUE=48000000
RCC.HSI_VALUE=16000000
RCC.LSE_VALUE=32768
RCC.MSI_VALUE=4000000
RCC.PLLSAI1N=16
RCC.USBFreq_Value=32000000
RCC.VCOOutputFreq_Value=32000000
board=custom

// file: Core/Src/main.c
/* USER CODE BEGIN Header */
/**
  ******************************************************************************
  * @file           : main.c
  * @brief          : Main program body
  ******************************************************************************
  * @attention
  *
  * Copyright (c) 2025 STMicroelectronics.
  * All rights reserved.
  *
  * This software is licensed under terms that can be found in the LICENSE file
  * in the root directory of this software component.
  * If no LICENSE file comes with this software, it is provided AS-IS.
  *
  ******************************************************************************
  */
/* USER CODE END Header */
#include "main.h"

void SystemClock_Config(void);

/* USER CODE BEGIN 0 */
int data; // 4 BYTES
/* USER CODE END 0 */

int main(void)
{

  /* MCU Configuration--------------------------------------------------------*/

  /* Reset of all peripherals, Initializes the Flash interface and the Systick. */
  HAL_Init();

  /* Configure the system clock */
  SystemClock_Config();

  /* Initialize all configured peripherals */
  /* USER CODE BEGIN 2 */
  RCC->AHB2ENR |= RCC_AHB2ENR_ADCEN;// CLOCK SIGNAL ENABLE

  ADC1_COMMON->CCR |= ADC_CCR_CKMODE_0;// SPECIFIC CLOCK SIGNAL FOR ADC

  ADC1->CR &= ~ADC_CR_DEEPPWD;// DEEP SLEEP MODE DISABLE
  ADC1->CR |= ADC_CR_ADVREGEN;// VOLTAGE REGULATOR
  HAL_Delay(100);// TO CONFIGURE THE ABOVE SETTING WAIT
  ADC1->CR &= ~ADC_CR_ADEN;// ADC ENABLE
//  Without Calibration ADC runs properly with some noise see it

  ADC1->CR &= ~ADC_CR_ADCALDIF;// CALIBRATION START
  ADC1->CR |= ADC_CR_ADCAL;

  while((ADC1->CR & ADC_CR_ADCAL) == ADC_CR_ADCAL);//zero
  // DEFINE PIN OUT
  ADC1->SQR1 |= ADC_SQR1_SQ1_1;// SEQUENCE CHANNEL 2
  ADC1->ISR |= ADC_ISR_ADRDY;
  ADC1->CR |= ADC_CR_ADEN;// ADC ENABLE
  while((ADC1->ISR & ADC_ISR_ADRDY)==0);// WAIT

  /* USER CODE END 2 */

  /* Infinite loop */
  /* USER CODE BEGIN WHILE */
  while (1)
  {
	  // ADC 12BIT SAR ADC 4096 value
	  ADC1->CR |= ADC_CR_ADSTART;// ADC START
	  while((ADC1->ISR & ADC_ISR_EOC)==0); // END OF CONVERSION
	  ADC1->ISR |= ADC_ISR_EOC;// FLAG
	  data = ADC1->DR;// DATA
	  HAL_Delay(100);// EVERY 100 MILLI SECONDS
    /* USER CODE END WHILE */

  }
}

void SystemClock_Config(void)
{
  RCC_OscInitTypeDef RCC_OscInitStruct = {0};
  RCC_ClkInitTypeDef RCC_ClkInitStruct = {0};

  /** Configure the main internal regulator output voltage
  */
  if (HAL_PWREx_ControlVoltageScaling(PWR_REGULATOR_VOLTAGE_SCALE1) != HAL_OK)
  {
    Error_Handler();
  }

  /** Initializes the RCC Oscillators according to the specified parameters
  * in the RCC_OscInitTypeDef structure.
  */
  RCC_OscInitStruct.OscillatorType = RCC_OSCILLATORTYPE_MSI;
  RCC_OscInitStruct.MSIState = RCC_MSI_ON;
  RCC_OscInitStruct.MSICalibrationValue = 0;
  RCC_OscInitStruct.MSIClockRange = RCC_MSIRANGE_6;
  RCC_OscInitStruct.PLL.PLLState = RCC_PLL_NONE;
  if (HAL_RCC_OscConfig(&RCC_OscInitStruct) != HAL_OK)
  {
    Error_Handler();
  }

  /** Initializes the CPU, AHB and APB buses clocks
  */
  RCC_ClkInitStruct.ClockType = RCC_CLOCKTYPE_HCLK|RCC_CLOCKTYPE_SYSCLK
                              |RCC_CLOCKTYPE_PCLK1|RCC_CLOCKTYPE_PCLK2;
  RCC_ClkInitStruct.SYSCLKSource = RCC_SYSCLKSOURCE_MSI;
  RCC_ClkInitStruct.AHBCLKDivider = RCC_SYSCLK_DIV1;
  RCC_ClkInitStruct.APB1CLKDivider = RCC_HCLK_DIV1;
  RCC_ClkInitStruct.APB2CLKDivider = RCC_HCLK_DIV1;

  if (HAL_RCC_ClockConfig(&RCC_ClkInitStruct, FLASH_LATENCY_0) != HAL_OK)
  {
    Error_Handler();
  }
}

void Error_Handler(void)
{
  __disable_irq();
  while (1)
  {
  }
}
